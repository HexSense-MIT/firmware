## Thesis_Camera/swdm031_img_xfer-main/usp_preview/usp_zephyr/west.yml
```yaml
manifest:
  projects:
  - import: true
    name: zephyr
    revision: v4.2.0
    url: https://github.com/zephyrproject-rtos/zephyr
  - name: usp
    path: modules/lib/usp
    revision: FLRC_BURST_2026-01-27
    submodules: true
    url: https://github.com/Lora-net/usp.git
  self:
    path: application
```
